## config/boards/shields/yzp70/Kconfig.defconfig
```kconfig
# Copyright (c) 2020 The ZMK Contributors
# SPDX-License-Identifier: MIT

if SHIELD_YZP70

config ZMK_KEYBOARD_NAME
    default "yzp70"

endif
```

## config/boards/shields/yzp70/Kconfig.shield
```kconfig
# Copyright (c) 2020 The ZMK Contributors
# SPDX-License-Identifier: MIT

config SHIELD_YZP70
    def_bool $(shields_list_contains,yzp70)
```
